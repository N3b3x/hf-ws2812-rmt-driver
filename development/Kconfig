## development/Kconfig
```kconfig
menu "HF-ESP32-WS2812-RMT Configuration"

choice WS1812_LED_TYPE
	prompt "LED Type"
	default WS2812_LED_TYPE_RGB
	help
		Select the type of LED that will be used. This will affect the order of the RGB values that will be sent to the LED.
	
	config WS2812_LED_TYPE_RGB
		bool "RGB"
		help
			Select this option if the LED is of type RGB.

	config WS2812_LED_TYPE_RGBW
		bool "RGBW"
		help
			Select this option if the LED is of type RGBW.
endchoice


config WS2812_NUM_LEDS
    int "Number of LEDs in the WS2812 strip."
    default 8
    help
	Specify the number of LEDs that will be controlled through the component. Keep in mind that for every LED in the strip an RGB value needs to be stored in a buffer.

config WS2812_LED_RMT_TX_CHANNEL
        int "RMT channel number (-1 for auto)"
        default -1
        help
        Select a fixed RMT channel to use for output. Set to -1 to let the
        driver pick the first free channel automatically. On ESP32-C6 only
        channels 0-3 are available.

config WS2812_LED_RMT_TX_GPIO
	int "GPIO number where the WS2812 strip is connected."
    default 18
    help
	Specify which GPIO should be used to send the signal. Only Output pins can be used: 0-5 or 12-33 should be ok.

config WS2812_T0H
	int "0 bit high time"
    default 14
    help
	Time interval the signal should be high when a 0 bit is transmitted.

config WS2812_T1H
	int "1 bit high time"
    default 52
    help
	Time interval the signal should be high when a 1 bit is transmitted.

config WS2812_T0L
	int "0 bit low time"
    default 52
    help
	Time interval the signal should be low followed by the high time for a 0 bit.

config WS2812_T1L
        int "1 bit low time"
    default 52
    help
        Time interval the signal should be low followed by the high time for a 1 bit.

config WS2812_DEFAULT_BRIGHTNESS
    int "Default brightness (0-255)"
    range 0 255
    default 255
    help
        Initial global brightness for the LED strip. This value scales
        all RGB(W) values before transmission. 255 means full brightness,
        while lower values dim the output proportionally.

endmenu
```
